## config/west.yml
```yaml
manifest:
  remotes:
    - name: zmkfirmware
      url-base: https://github.com/zmkfirmware
    - name: davidphilipbarr
      url-base: https://github.com/davidphilipbarr
    - name: zunixorn
      url-base: https://github.com/zUnixorn
  projects:
    - name: zmk
      remote: zmkfirmware
      revision: main
      import: app/west.yml
    - name: nicehatharry
      remote: davidphilipbarr
      clone-depth: 1
      revision: main
    - name: zmk-nice-view-custom
      remote: zunixorn
      clone-depth: 1
      revision: no-wpm
    - name: zmk-oneshot-mod
      remote: zunixorn
      clone-depth: 1
  self:
    path: config
```
